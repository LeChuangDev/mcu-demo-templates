## ESP32S3_Demo/Config/sdkconfig.defaults
```kconfig
# =====================================================================
#  工程默认配置：首次 idf.py build 时用本文件生成工程根目录的 sdkconfig
#
#  - 这里只放团队共享的稳定配置；个人临时改动请用 menuconfig，
#    生成的 sdkconfig 含本机配置，已被 .gitignore 排除，不要提交。
#  - 改这里之后需要执行一次 fullclean 才会重新生成 sdkconfig。
# =====================================================================

# 目标芯片
CONFIG_IDF_TARGET="esp32s3"
```

## ESP_S3_Demo/Config/sdkconfig.defaults
```kconfig
# =====================================================================
#  工程默认配置：首次 idf.py build 时用本文件生成工程根目录的 sdkconfig
#
#  - 这里只放团队共享的稳定配置；个人临时改动请用 menuconfig，
#    生成的 sdkconfig 含本机配置，已被 .gitignore 排除，不要提交。
#  - 改这里之后需要执行一次 fullclean 才会重新生成 sdkconfig。
# =====================================================================

# 目标芯片
CONFIG_IDF_TARGET="esp32s3"

# =====================================================================
#  Flash 容量（换板子时改这里，然后执行 fullclean 重新生成 sdkconfig）
#  本模板默认按 16MB 配置（常见于 N16R8 等模组）。
#  其它容量把下面一行替换成对应选项：
#    2MB  -> CONFIG_ESPTOOLPY_FLASHSIZE_2MB=y
#    4MB  -> CONFIG_ESPTOOLPY_FLASHSIZE_4MB=y
#    8MB  -> CONFIG_ESPTOOLPY_FLASHSIZE_8MB=y
#    16MB -> CONFIG_ESPTOOLPY_FLASHSIZE_16MB=y
# =====================================================================
CONFIG_ESPTOOLPY_FLASHSIZE_16MB=y

# =====================================================================
#  PSRAM（按板子选开）
#  板子带 PSRAM（如 N16R8 的 8MB）时取消下面两行注释；没有 PSRAM 的
#  板子请保持注释，否则启动会失败。改完执行 fullclean 重新编译。
# =====================================================================
# CONFIG_SPIRAM=y
# CONFIG_SPIRAM_MODE_OCT=y
```
